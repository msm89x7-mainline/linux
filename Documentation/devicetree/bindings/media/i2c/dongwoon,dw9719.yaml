## Documentation/devicetree/bindings/media/i2c/dongwoon,dw9719.yaml
```yaml
# SPDX-License-Identifier: (GPL-2.0 OR BSD-2-Clause)
%YAML 1.2
---
$id: http://devicetree.org/schemas/media/i2c/dongwoon,dw9719.yaml#
$schema: http://devicetree.org/meta-schemas/core.yaml#

title: Dongwoon Anatech DW9719 Voice Coil Motor (VCM) DAC

maintainers:
  - Daniel Scally <djrscally@gmail.com>

description: |-
  The Dongwoon DW9719/DW9718S is a single 10-bit digital-to-analog converter
  with 100 mA output current sink capability, designed for linear control of
  voice coil motors (VCM) in camera lenses. This chip provides a Smart Actuator
  Control (SAC) mode intended for driving voice coil lenses in camera modules.

properties:
  compatible:
    enum:
      - dongwoon,dw9719
      - dongwoon,dw9718s

  reg:
    maxItems: 1

  vdd-supply:
    description: VDD power supply

  dongwoon,sac-mode:
    description: |
      Slew Rate Control mode to use: direct, LSC (Linear Slope Control) or
      SAC1-SAC6 (Smart Actuator Control).
    $ref: /schemas/types.yaml#/definitions/uint32
    enum:
      - 0    # Direct mode
      - 1    # LSC mode
      - 2    # SAC1 mode (operation time# 0.32 x Tvib)
      - 3    # SAC2 mode (operation time# 0.48 x Tvib)
      - 4    # SAC3 mode (operation time# 0.72 x Tvib)
      - 5    # SAC4 mode (operation time# 1.20 x Tvib)
      - 6    # SAC5 mode (operation time# 1.64 x Tvib)
      - 7    # SAC6 mode (operation time# 1.88 x Tvib)
    default: 4

  dongwoon,vcm-freq:
    description:
      The switching frequency for the voice coil motor.
    $ref: /schemas/types.yaml#/definitions/uint32

allOf:
  - if:
      properties:
        compatible:
          contains:
            const: dongwoon,dw9718s
    then:
      properties:
        dongwoon,vcm-freq:
          default: 0
          enum:
            - 0    # 5.00 MHz
            - 1    # 3.33 MHz
            - 2    # 2.50 MHz
            - 3    # 2.00 MHz
            - 4    # 1.67 MHz
            - 5    # 1.43 MHz
            - 6    # 1.25 MHz
            - 7    # 1.11 MHz
            - 8    # 1.00 MHz
            - 9    # 0.91 MHz
            - 10   # 0.83 MHz
            - 11   # 0.77 MHz
            - 12   # 0.71 MHz
            - 13   # 0.67 MHz
            - 14   # 0.63 MHz
            - 15   # 0.59 MHz
  - if:
      properties:
        compatible:
          contains:
            const: dongwoon,dw9719
    then:
      properties:
        dongwoon,vcm-freq:
          default: 0x60

required:
  - compatible
  - reg
  - vdd-supply

additionalProperties: false

examples:
  - |

    i2c {
        #address-cells = <1>;
        #size-cells = <0>;

        vcm_rear: camera-lens@c {
            compatible = "dongwoon,dw9718s";
            reg = <0x0c>;

            vdd-supply = <&pm8937_l17>;
        };
    };

...
```

## drivers/gpu/drm/panel/msm89x7-generated/Kconfig
```kconfig
menu "MSM89x7 panel drivers generated with linux-mdss-dsi-panel-driver-generator"
	depends on GPIOLIB && OF && REGULATOR
	depends on DRM_MIPI_DSI

config DRM_PANEL_MSM89X7_GENERATED
	tristate "Select all generated MSM89X7 panel drivers by default"

config DRM_PANEL_MOTOROLA_CEDRIC_NT35596_INX
	tristate "Motorola CEDRIC NT35596 INX"
	default DRM_PANEL_MSM89X7_GENERATED

config DRM_PANEL_MOTOROLA_CEDRIC_NT35596_TIANMA
	tristate "Motorola CEDRIC NT35596 TIANMA"
	default DRM_PANEL_MSM89X7_GENERATED

config DRM_PANEL_MOTOROLA_MONTANA_NT35596_INX
	tristate "Motorola MONTANA NT35596 INX"
	default DRM_PANEL_MSM89X7_GENERATED

config DRM_PANEL_MOTOROLA_MONTANA_R63350_TIANMA
	tristate "Motorola MONTANA R63350 TIANMA"
	default DRM_PANEL_MSM89X7_GENERATED

config DRM_PANEL_XIAOMI_LAND_HX8394F_BOE
	tristate "Xiaomi LAND HX8394F BOE"
	default DRM_PANEL_MSM89X7_GENERATED

config DRM_PANEL_XIAOMI_LAND_ILI9881C_TIANMA
	tristate "Xiaomi LAND ILI9881C TIANMA"
	default DRM_PANEL_MSM89X7_GENERATED

config DRM_PANEL_XIAOMI_LAND_NT35521S_EBBG
	tristate "Xiaomi LAND NT35521S EBBG"
	default DRM_PANEL_MSM89X7_GENERATED

config DRM_PANEL_XIAOMI_RIVA_HX8394F_BOE
	tristate "Xiaomi RIVA HX8394F BOE"
	default DRM_PANEL_MSM89X7_GENERATED

config DRM_PANEL_XIAOMI_RIVA_ILI9881C_EBBGDJN
	tristate "Xiaomi RIVA ILI9881C EBBGDJN"
	default DRM_PANEL_MSM89X7_GENERATED

config DRM_PANEL_XIAOMI_RIVA_ILI9881C_EBBG
	tristate "Xiaomi RIVA ILI9881C EBBG"
	default DRM_PANEL_MSM89X7_GENERATED

config DRM_PANEL_XIAOMI_RIVA_ILI9881C_TIANMA
	tristate "Xiaomi RIVA ILI9881C TIANMA"
	default DRM_PANEL_MSM89X7_GENERATED

config DRM_PANEL_XIAOMI_SANTONI_HX8394F_BOE
	tristate "Xiaomi SANTONI HX8394F BOE"
	default DRM_PANEL_MSM89X7_GENERATED

config DRM_PANEL_XIAOMI_SANTONI_ILI9881C_EBBGDJN
	tristate "Xiaomi SANTONI ILI9881C EBBGDJN"
	default DRM_PANEL_MSM89X7_GENERATED

config DRM_PANEL_XIAOMI_SANTONI_ILI9881C_EBBG
	tristate "Xiaomi SANTONI ILI9881C EBBG"
	default DRM_PANEL_MSM89X7_GENERATED

config DRM_PANEL_XIAOMI_UGGLITE_ILI9881C_SC
	tristate "Xiaomi UGGLITE ILI9881C SC"
	default DRM_PANEL_MSM89X7_GENERATED

config DRM_PANEL_XIAOMI_UGGLITE_OTM1901A_HX
	tristate "Xiaomi UGGLITE OTM1901A HX"
	default DRM_PANEL_MSM89X7_GENERATED

config DRM_PANEL_XIAOMI_UGGLITE_OTM1901A_TM
	tristate "Xiaomi UGGLITE OTM1901A TM"
	default DRM_PANEL_MSM89X7_GENERATED

endmenu
```
