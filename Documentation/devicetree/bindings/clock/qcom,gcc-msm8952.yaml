## Documentation/devicetree/bindings/clock/qcom,gcc-msm8952.yaml
```yaml
# SPDX-License-Identifier: GPL-2.0-only
%YAML 1.2
---
$id: http://devicetree.org/schemas/clock/qcom,gcc-msm8952.yaml#
$schema: http://devicetree.org/meta-schemas/core.yaml#

title: Qualcomm Global Clock & Reset Controller on MSM8952

maintainers:
  - Muzaffer Kadir <muzafferkadir@proton.me>

description: |
  Qualcomm global clock control module provides the clocks, resets and power
  domains on MSM8952.

  See also::
    include/dt-bindings/clock/qcom,gcc-msm8952.h

properties:
  compatible:
    enum:
      - qcom,gcc-msm8952

  clocks:
    items:
      - description: XO source
      - description: Always-on XO source
      - description: DSI phy instance 0 dsi clock
      - description: DSI phy instance 0 byte clock

  clock-names:
    items:
      - const: xo
      - const: xo_a
      - const: dsi0pll
      - const: dsi0pllbyte

required:
  - compatible
  - '#power-domain-cells'

allOf:
  - $ref: qcom,gcc.yaml#

unevaluatedProperties: false

examples:
  - |
    clock-controller@300000 {
      compatible = "qcom,gcc-msm8952";
      #clock-cells = <1>;
      #reset-cells = <1>;
      #power-domain-cells = <1>;
      reg = <0x300000 0x90000>;
    };
...
```

## Documentation/devicetree/bindings/pinctrl/qcom,msm8952-pinctrl.yaml
```yaml
# SPDX-License-Identifier: (GPL-2.0-only OR BSD-2-Clause)
%YAML 1.2
---
$id: http://devicetree.org/schemas/pinctrl/qcom,msm8952-pinctrl.yaml#
$schema: http://devicetree.org/meta-schemas/core.yaml#

title: Qualcomm MSM8952 TLMM pin controller

maintainers:
  - Muzaffer Kadir <muzafferkadir@proton.me>

description:
  Top Level Mode Multiplexer pin controller in Qualcomm MSM8952 SoC.

properties:
  compatible:
    const: qcom,msm8952-pinctrl

  reg:
    maxItems: 1

  interrupts:
    maxItems: 1

  gpio-reserved-ranges:
    minItems: 1
    maxItems: 61

  gpio-line-names:
    maxItems: 134

patternProperties:
  "-state$":
    oneOf:
      - $ref: "#/$defs/qcom-msm8952-tlmm-state"
      - patternProperties:
          "-pins$":
            $ref: "#/$defs/qcom-msm8952-tlmm-state"
        additionalProperties: false

$defs:
  qcom-msm8952-tlmm-state:
    type: object
    description:
      Pinctrl node's client devices use subnodes for desired pin configuration.
      Client device subnodes use below standard properties.
    $ref: qcom,tlmm-common.yaml#/$defs/qcom-tlmm-state
    unevaluatedProperties: false

    properties:
      pins:
        description:
          List of gpio pins affected by the properties specified in this
          subnode.
        items:
          oneOf:
            - pattern: "^gpio([0-9]|[1-9][0-9]|1[0-2][0-9]|13[0-4])$"
            - enum: [ qdsd_clk, qdsd_cmd, qdsd_data0, qdsd_data1, qdsd_data2,
                      qdsd_data3, sdc1_clk, sdc1_cmd, sdc1_data, sdc1_rclk,
                      sdc2_clk, sdc2_cmd, sdc2_data ]
        minItems: 1
        maxItems: 36

      function:
        description:
          Specify the alternative function to be configured for the specified
          pins.

        enum: [ gpio, blsp_uart1, mipi_dsi0, blsp_spi1, smb_int,
                adsp_ext, blsp_i2c1, prng_rosc, qdss_cti_trig_out_b0, rcm_marker2,
                qdss_cti_trig_out_a1, blsp_spi2, blsp_uart2, ldo_update, qdss_tracedata_b,
                pbs1, pwr_modem_enabled_b, blsp_i2c3, gcc_gp2_clk_b, atest_combodac_to_gpio_native,
                ldo_en, blsp_i2c2, gcc_gp1_clk_b, atest_gpsadc_dtest0_native, blsp_spi3,
                blsp_uart3, sec_mi2s, pbs0, gcc_gp3_clk_b, blsp_spi4,
                blsp_uart4, pbs2, pwr_nav_enabled_b, codec_mad, pwr_crypto_enabled_b,
                blsp_i2c4, nfc_disable, blsp_spi5, blsp_uart5, qdss_traceclk_a,
                atest_bbrx1, nfc_irq, qdss_tracectl_b, qdss_cti_trig_in_b0, blsp_i2c6,
                qdss_traceclk_b, atest_wlan0, m_voc, qdss_cti_trig_in_a0, atest_bbrx0,
                blsp_i2c5, qdss_tracectl_a, atest_gpsadc_dtest1_native, qdss_tracedata_a, blsp_spi6,
                blsp_uart6, atest_wlan1, mdp_vsync, pri_mi2s_mclk_a, sec_mi2s_mclk_a,
                cam_mclk, cci_i2c, pwr_modem_enabled_a, flash_strobe, cci_timer0,
                cci_timer1, cam1_standby, pwr_nav_enabled_a, cam1_rst, pwr_crypto_enabled_a,
                cam2_standby, cam2_rst, webcam_standby, cci_async, webcam_rst,
                rcm_marker1, sd_write, qdss_cti_trig_out_a0, accel_int, gcc_gp1_clk_a,
                alsp_int, gcc_gp2_clk_a, mag_int, gcc_gp3_clk_a, gyro_int,
                pressure_int, fp_gpio, blsp6_spi, fp_int, qdss_cti_trig_in_b1,
                uim_batt, qdss_cti_trig_out_b1, uim1_data, uim1_clk, uim1_reset,
                uim1_present, uim2_data, uim2_clk, uim2_reset, uim2_present,
                uim3_data, usb_fs, uim3_clk, uim3_reset, uim3_present,
                us_euro, atest_char3, dbg_out, bimc_dte0, ts_resout,
                ts_sample, sec_mi2s_mclk_b, pri_mi2s, sdcard_det, atest_char1,
                ebi_cdc, audio_reset, atest_char0, cdc_pdm0, pri_mi2s_mclk_b,
                lpass_slimbus, lpass_slimbus0, lpass_slimbus1, codec_int1,
                codec_int2, wcss_bt, atest_char2, ebi_ch0, wcss_wlan2,
                wcss_wlan1, wcss_wlan0, wcss_wlan, wcss_fm, ext_lpass,
                key_volp, key_snapshot, key_focus, gcc_tlmm, key_home,
                dmic0_clk, dmic0_data, backlight_en, qdss_cti_trig_in_a1, lcd_en,
                blsp_spi7, blsp_uart7, pri_mi2s_ws, usbc_irq, wsa_io,
                blsp_i2c7, uim3_ldo, blsp_spi8, blsp_uart8, wsa_irq,
                blsp_i2c8, gcc_plltest, nav_pps_in_a, pa_indicator,
                nav_pps_in_b, nav_pps, modem_tsync, nav_tsync, ssbi_wtr1,
                gsm1_tx, gsm0_tx, atest_char, atest_tsens, bimc_dte1 ]

    required:
      - pins

allOf:
  - $ref: /schemas/pinctrl/qcom,tlmm-common.yaml#

required:
  - compatible
  - reg

unevaluatedProperties: false

examples:
  - |
    #include <dt-bindings/interrupt-controller/arm-gic.h>

    msmgpio: pinctrl@1000000 {
        compatible = "qcom,msm8952-pinctrl";
        reg = <0x01000000 0x300000>;
        interrupts = <GIC_SPI 208 IRQ_TYPE_LEVEL_HIGH>;
        gpio-controller;
        gpio-ranges = <&msmgpio 0 0 134>;
        #gpio-cells = <2>;
        interrupt-controller;
        #interrupt-cells = <2>;

        blsp1-uart2-sleep-state {
            pins = "gpio4", "gpio5";
            function = "gpio";

            drive-strength = <2>;
            bias-pull-down;
        };

        spi1-default-state {
            spi-pins {
                pins = "gpio0", "gpio1", "gpio3";
                function = "blsp_spi1";

                drive-strength = <12>;
                bias-disable;
            };

            cs-pins {
                pins = "gpio2";
                function = "blsp_spi1";

                drive-strength = <2>;
                bias-disable;
            };
        };
    };
```

## Documentation/devicetree/bindings/power/supply/qcom,pmi8998-charger.yaml
```yaml
# SPDX-License-Identifier: GPL-2.0 OR BSD-2-Clause
%YAML 1.2
---
$id: http://devicetree.org/schemas/power/supply/qcom,pmi8998-charger.yaml#
$schema: http://devicetree.org/meta-schemas/core.yaml#

title: Qualcomm Switch-Mode Battery Charger "2" and "5"

maintainers:
  - Casey Connolly <casey.connolly@linaro.org>

description: |
  The charger peripheral of a Qualcomm PMIC, in either of two generations:
  SMB2 on the PMI8998 and PM660, and SMB5 on the PMI632. They differ in the
  register layout and in which analog channels the PMIC routes, not in the
  shape of this binding.

properties:
  compatible:
    enum:
      - qcom,pmi8998-charger
      - qcom,pm660-charger
      - qcom,pmi632-charger

  reg:
    maxItems: 1

  interrupts:
    maxItems: 4

  interrupt-names:
    items:
      - const: usb-plugin
      - const: bat-ov
      - const: wdog-bark
      - const: usbin-icl-change

  io-channels:
    minItems: 2
    items:
      - description: USB in current in uA
      - description: USB in voltage in uV
      - description: Battery voltage in uV
      - description: Battery thermistor, as a raw ADC code
      - description: Battery ID resistor divider voltage in uV

  io-channel-names:
    minItems: 2
    items:
      - const: usbin_i
      - const: usbin_v
      - const: vbat
      - const: bat_therm
      - const: bat_id

  monitored-battery: true

  qcom,batt-id-pullup-ohms:
    maxItems: 1
    description: |
      Resistance of the pull-up from the PMIC reference to the BAT_ID net, in
      ohms. Together with the voltage read on the bat_id channel this gives the
      resistance of the identification resistor inside the pack, which is
      compared against the id-resistor-ohms of the monitored battery. Describe
      it only on boards that route BAT_ID.

  qcom,batt-id-tolerance-percent:
    maxItems: 1
    description: |
      How far, as a percentage, the resistance measured through that divider
      may differ from the monitored battery's id-resistor-ohms and still count
      as the same pack. The tolerance belongs here rather than to the cell
      because it has to cover the divider and the ADC as well as the resistor
      itself.

  qcom,auto-recharge-microvolt:
    description: |
      Battery voltage, in microvolts, below which a finished charge is started
      again. Must be below the monitored battery's
      constant-charge-voltage-max-microvolt. Absent, the comparator keeps
      whatever threshold it powers up with.

  qcom,jeita-hard-thresholds:
    $ref: /schemas/types.yaml#/definitions/uint32-array
    minItems: 2
    maxItems: 2
    description: |
      The pair of raw BAT_THERM ADC codes { cold, hot } outside which charging
      stops outright, cold first. These are codes rather than temperatures
      because the comparators take codes, and which code a temperature produces
      depends on this PMIC's ADC full scale and on the board's pull-up as much
      as on the cell - which is also why they are described here and not on the
      battery.

  qcom,jeita-soft-thresholds:
    $ref: /schemas/types.yaml#/definitions/uint32-array
    minItems: 2
    maxItems: 2
    description: |
      The pair of raw BAT_THERM ADC codes { cold, hot } inside which the pack
      may be charged at full current, in the same units and for the same reason
      as qcom,jeita-hard-thresholds. Between a soft and a hard threshold the
      charge current is reduced instead of stopped.

  qcom,jeita-soft-fcc-microamp:
    minItems: 2
    maxItems: 2
    description: |
      Fast-charge current, in microamperes, to be left with in the cool and the
      warm soft zone, in that order. The hardware subtracts a fixed offset from
      whatever current is programmed, so describing the wanted result rather
      than the offset keeps the property meaningful when the current changes.

  qcom,thermal-mitigation:
    $ref: /schemas/types.yaml#/definitions/uint32-array
    minItems: 2
    maxItems: 16
    description: |
      Fast-charge current limit, in microamperes, for each state of the cooling
      device the charger registers. The first entry is cooling state 0 and must
      be the most permissive; entries must not increase. A thermal zone reduces
      the charge current by requesting a higher state, so state 0 is what the
      charger falls back to when nothing is throttling it.

  '#cooling-cells':
    const: 2

required:
  - compatible
  - reg
  - interrupts
  - interrupt-names
  - io-channels
  - io-channel-names
  - monitored-battery

allOf:
  - $ref: power-supply.yaml#

additionalProperties: false

examples:
  - |
    #include <dt-bindings/interrupt-controller/irq.h>

    pmic {
      #address-cells = <1>;
      #size-cells = <0>;

      charger@1000 {
        compatible = "qcom,pmi8998-charger";
        reg = <0x1000>;

        interrupts = <0x2 0x12 0x2 IRQ_TYPE_EDGE_BOTH>,
                     <0x2 0x13 0x4 IRQ_TYPE_EDGE_BOTH>,
                     <0x2 0x13 0x6 IRQ_TYPE_EDGE_RISING>,
                     <0x2 0x16 0x1 IRQ_TYPE_EDGE_RISING>;
        interrupt-names = "usb-plugin", "bat-ov", "wdog-bark", "usbin-icl-change";

        io-channels = <&pmi8998_rradc 3>,
                      <&pmi8998_rradc 4>;
        io-channel-names = "usbin_i",
                           "usbin_v";

        monitored-battery = <&battery>;
      };
    };

  - |
    #include <dt-bindings/interrupt-controller/irq.h>
    #include <dt-bindings/iio/qcom,spmi-vadc.h>

    pmic {
      #address-cells = <1>;
      #size-cells = <0>;

      charger@1000 {
        compatible = "qcom,pmi632-charger";
        reg = <0x1000>;

        interrupts = <0x2 0x13 0x4 IRQ_TYPE_EDGE_BOTH>,
                     <0x2 0x12 0x2 IRQ_TYPE_EDGE_BOTH>,
                     <0x2 0x16 0x1 IRQ_TYPE_EDGE_RISING>,
                     <0x2 0x13 0x6 IRQ_TYPE_EDGE_RISING>;
        interrupt-names = "usb-plugin", "bat-ov", "wdog-bark", "usbin-icl-change";

        io-channels = <&pmi632_adc ADC5_USB_IN_I>,
                      <&pmi632_adc ADC5_USB_IN_V_16>,
                      <&pmi632_adc ADC5_VBAT_SNS>,
                      <&pmi632_adc ADC5_BAT_THERM_100K_PU>,
                      <&pmi632_adc ADC5_BAT_ID_100K_PU>;
        io-channel-names = "usbin_i", "usbin_v", "vbat",
                           "bat_therm", "bat_id";

        monitored-battery = <&battery>;
        qcom,batt-id-pullup-ohms = <100000>;
        qcom,thermal-mitigation = <2000000 1500000 1000000 500000>;

        #cooling-cells = <2>;
      };
    };
```
