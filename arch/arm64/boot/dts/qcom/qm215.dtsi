// SPDX-License-Identifier: GPL-2.0-only

#include "msm8917.dtsi"

&modem {
	compatible = "qcom,qm215-mss-pil", "qcom,mdm9607-mss-pil";

	power-domains = <&rpmpd QM215_VDDCX>, <&rpmpd QM215_VDDMX>;
	power-domain-names = "cx", "mx";
};

&gcc {
	compatible = "qcom,gcc-qm215";
	clocks = <&xo_board>,
		 <&sleep_clk>,
		 <0>,
		 <0>;
		clock-names = "xo",
			      "sleep_clk",
			      "dsi0pll",
			      "dsi0pllbyte";
};

&rpmpd {
	compatible = "qcom,qm215-rpmpd";
};
