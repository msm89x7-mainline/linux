// SPDX-License-Identifier: BSD-3-Clause
/*
 * Copyright (c) 2025, Barnabas Czeman
 */

/dts-v1/;

#include "msm8937.dtsi"
#include "motorola-hannah-common.dtsi"

/ {
	compatible = "motorola,hannah", "qcom,msm8937";
	qcom,msm-id = <QCOM_ID_MSM8937 0>;
};

&wcnss_ctrl {
	firmware-name = "qcom/msm8937/motorola/hannah/WCNSS_qcom_wlan_nv.bin";
};
